PROVIDE(printf = 0x107f0c84);

PROVIDE(memcpy = 0x107f4f7c);
PROVIDE(memset = 0x107f5018);

PROVIDE(usleep = 0x1071d668);

PROVIDE(MMCGetDevice = 0x107187c4);
PROVIDE(MMCPrepareCommand = 0x10718428);
PROVIDE(MMCExecuteCommand = 0x10718fcc);
PROVIDE(MMCConvertTimeout = 0x10718208);

PROVIDE(MMCPhysStartCommand = 0x1071c958);

PROVIDE(AllocPool_Get = 0x1071dc8c);
PROVIDE(AllocPool_Ret = 0x1071dd0c);

PROVIDE(FSA_HandleIoctl = 0x107010a8);
PROVIDE(FSA_HandleIoctlv = 0x10703164);

PROVIDE(IOS_ResourceReply = 0x107f6b4c);

PROVIDE(IOS_WaitSemaphore = 0x107f6bc4);
PROVIDE(IOS_SignalSemaphore = 0x107f6bcc);

PROVIDE(mdBlkDrivers = 0x11c39e78);
